/*
 * Copyright (c) 2020 Derek Schmell
 *
 * SPDX-License-Identifier: MIT
 */

#include "cosmos.dtsi"

&default_transform {
	col-offset = <6>;
};

&kscan0 {
    row-gpios
        = <&xiao_d 0  (GPIO_ACTIVE_HIGH | GPIO_PULL_DOWN)>
        , <&xiao_d 1  (GPIO_ACTIVE_HIGH | GPIO_PULL_DOWN)>
        , <&xiao_d 2  (GPIO_ACTIVE_HIGH | GPIO_PULL_DOWN)>
        , <&xiao_d 3  (GPIO_ACTIVE_HIGH | GPIO_PULL_DOWN)>
        , <&xiao_d 4  (GPIO_ACTIVE_HIGH | GPIO_PULL_DOWN)>
        , <&xiao_d 5  (GPIO_ACTIVE_HIGH | GPIO_PULL_DOWN)>
        ;
};

&right_encoder {
    status = "okay";
};

